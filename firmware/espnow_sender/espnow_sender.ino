// ESP-NOW prompt sender: type a prompt over serial, send its token IDs to the
// P4 inference board via ESP-NOW broadcast. Runs on any ESP32 with WiFi
// (S3, C5, C6, original ESP32 -- anything except the P4 itself).
//
// Also receives and prints generated tokens broadcast by the P4.
//
// EA-04: All TX frames are signed with crypto_envelope.h when USE_CRYPTO
// is enabled. RX frames are verified before processing.
//
// Usage:
//   1. Flash this to any spare ESP32 board.
//   2. Open serial monitor at 115200 baud.
//   3. Type a prompt and press Enter.
//   4. Watch the P4's generated text appear in real time.

#include <esp_now.h>
#include <WiFi.h>
#include <esp_mac.h>
#include <esp_random.h>
#include <nvs_flash.h>
#include <nvs.h>
#include "../esp32_llm/vocab.h"   // shared token->text table for decoding RX
#include "../common/crypto_envelope.h"
#include "sender_replay.h"
#include "ota_push.h"

#define ESPNOW_MSG_TOKEN  0x01
#define ESPNOW_MSG_PROMPT 0x02

static const uint8_t BROADCAST[] = {0xFF, 0xFF, 0xFF, 0xFF, 0xFF, 0xFF};
#ifndef ESPNOW_BROADCAST
#define ESPNOW_BROADCAST BROADCAST
#endif

// EA-04: sender-side crypto state.
#ifndef USE_CRYPTO
#define USE_CRYPTO 1
#endif

#if USE_CRYPTO
static const char *_sender_psk = CRYPTO_PSK;
static uint32_t _sender_epoch = 0;
static uint32_t _sender_tx_seq = 0;
// This device's own MAC, bound into the HMAC as additional authenticated
// data (R5-02) so a captured valid frame can't be replayed under a
// different claimed source MAC.
static uint8_t _sender_own_mac[6];
// R5-01 (verification-memo hardening): set only once epoch allocation and
// replay-floor persistence both succeed. sender_send()/on_rx() refuse to
// operate at all while this is false -- no random-epoch fallback, no
// unauthenticated pass-through.
static bool _sender_crypto_ready = false;
#endif

// Hardcoded prompt token tables. In a full system you'd run a tokenizer
// on-device or send raw text; for the demo, these cover common openers.
// Generated by: python src/gen_assets.py (prints token IDs for a prompt).
struct PromptEntry { const char *text; const int *ids; int n; };

static const int IDS_ONCE[] = {433, 447, 259, 405};         // "Once upon a time"
static const int IDS_THERE[] = {1788, 539, 259};             // "There was a"
static const int IDS_ONE[] = {4189, 1039, 267, 539, 259};   // "One day there was a"
static const int IDS_THE[] = {464};                           // "The"

static const PromptEntry PROMPTS[] = {
  {"once upon a time", IDS_ONCE, 4},
  {"there was a",      IDS_THERE, 3},
  {"one day there was a", IDS_ONE, 5},
  {"the",              IDS_THE, 1},
};
static const int N_PROMPTS = sizeof(PROMPTS) / sizeof(PROMPTS[0]);

// Peer protocol frame type for passive scanning.
#define ESPNOW_MSG_IDENTITY 0x04

// EA-04: sign and send a frame.
static void sender_send(const uint8_t *dest, uint8_t *frame, int len) {
#if USE_CRYPTO
  if (!_sender_crypto_ready) return;  // R5-01: no safe signing path -- refuse to send
  if (len > 0) {
    uint32_t seq = _sender_tx_seq++;
    len = crypto_env_sign(_sender_psk, _sender_own_mac, frame, len, _sender_epoch, seq);
  }
#endif
  esp_now_send(dest, frame, len);
}

// RX callback: print tokens received from the P4, scan for peer beacons,
// and dispatch OTA frames.
static void on_rx(const esp_now_recv_info_t *info, const uint8_t *data, int len) {
  if (len < 1) return;
#if USE_CRYPTO
  // R5-01: fail closed -- no safe verification path without a ready
  // epoch/floor. Must run before anything else in on_rx(), including the
  // OTA dispatch at the bottom, so no unauthenticated traffic (OTA or
  // otherwise) is ever processed while crypto never came up.
  if (!_sender_crypto_ready) return;
#endif

  // EA-04: verify incoming frames when crypto is enabled.
  // FR-02: sender-side replay protection.
  int verified_len = len;
#if USE_CRYPTO
  {
    uint32_t ep, sq;
    verified_len = crypto_env_verify(_sender_psk, info->src_addr, data, len, &ep, &sq);
    if (verified_len <= 0) return;
    if (!sender_replay_check(info->src_addr, ep, sq)) return;
  }
#endif

  if (data[0] == ESPNOW_MSG_TOKEN && verified_len >= 3) {
    uint16_t tok;
    memcpy(&tok, data + 1, 2);
    if (tok < VOCAB_N) {
      const unsigned char *bytes = VOCAB_BLOB + VOCAB_OFF[tok];
      int blen = VOCAB_OFF[tok + 1] - VOCAB_OFF[tok];
      Serial.write(bytes, blen);
    }
  }
  if (data[0] == ESPNOW_MSG_IDENTITY && verified_len >= 13) {
    uint32_t dev_id;
    memcpy(&dev_id, data + 1, 4);
    int nlen = verified_len - 12;
    if (nlen > 16) nlen = 16;
    Serial.printf("\n[scan] peer: %.*s (0x%08X)\n",
                  nlen, (const char *)(data + 12), dev_id);
  }
  _otap_rx(info, data, len);
}

static void send_prompt(const int *ids, int n) {
  // EA-04: cap prompt length to fit within 250 bytes with crypto envelope.
#if USE_CRYPTO
  if (n > 116) n = 116;
#else
  if (n > 120) n = 120;
#endif
  uint8_t frame[2 + 120 * 2 + CRYPTO_ENV_OVERHEAD];
  frame[0] = ESPNOW_MSG_PROMPT;
  frame[1] = (uint8_t)n;
  for (int i = 0; i < n; i++) {
    uint16_t id = (uint16_t)ids[i];
    memcpy(frame + 2 + i * 2, &id, 2);
  }
  sender_send(BROADCAST, frame, 2 + n * 2);
  Serial.printf("\nsent %d tokens via ESP-NOW\n", n);
}

void setup() {
  Serial.begin(115200);
  delay(1000);
  Serial.println("\n=== ESP-NOW Prompt Sender ===");

  // R5-01: NVS must be ready before the persistent epoch counter can be
  // loaded, so init it before anything else touches crypto state.
  esp_err_t nvs_err = nvs_flash_init();
  if (nvs_err == ESP_ERR_NVS_NO_FREE_PAGES ||
      nvs_err == ESP_ERR_NVS_NEW_VERSION_FOUND) {
    nvs_flash_erase();
    nvs_err = nvs_flash_init();
  }
  if (nvs_err != ESP_OK)
    Serial.printf("[nvs] init failed: %d\n", nvs_err);

  WiFi.mode(WIFI_STA);
  WiFi.disconnect();

  if (esp_now_init() != ESP_OK) {
    Serial.println("ESP-NOW init failed");
    return;
  }

  // R3-02: initialize crypto state BEFORE registering RX callback so
  // on_rx never processes frames without authentication.
  // R5-01 (verification-memo hardening): epoch allocation and replay-floor
  // persistence are now both fallible with no fallback -- ESP-NOW is only
  // enabled if both succeed.
#if USE_CRYPTO
  bool _epoch_ok = sender_next_persistent_epoch(&_sender_epoch);
  _sender_tx_seq = 0;
  esp_read_mac(_sender_own_mac, ESP_MAC_WIFI_STA);
  bool _floor_ok = sender_replay_init();
  _sender_crypto_ready = _epoch_ok && _floor_ok;
  if (_sender_crypto_ready) {
    _otap_epoch_ptr = &_sender_epoch;
    _otap_tx_seq_ptr = &_sender_tx_seq;
    _otap_crypto_enabled = true;
    Serial.printf("[crypto] HMAC-SHA256 enabled (epoch=0x%08X)\n", _sender_epoch);
  } else {
    Serial.println("[crypto] CRITICAL: init failed -- ESP-NOW will remain disabled");
  }
#endif

  // R4-04: initialize all callback-consumed state BEFORE registering
  // the RX callback to prevent processing frames with uninitialized data.
  ota_push_init();

#if USE_CRYPTO
  if (_sender_crypto_ready) {
#endif
    esp_now_register_recv_cb(on_rx);

    esp_now_peer_info_t peer = {};
    memcpy(peer.peer_addr, BROADCAST, 6);
    peer.channel = 0;
    peer.encrypt = false;
    esp_now_add_peer(&peer);
#if USE_CRYPTO
  } else {
    Serial.println("[espnow] disabled: crypto init failed, refusing unauthenticated ESP-NOW");
  }
#endif

  Serial.println("ready. type a prompt (or number 1-4):");
  for (int i = 0; i < N_PROMPTS; i++)
    Serial.printf("  %d: \"%s\"\n", i + 1, PROMPTS[i].text);
  Serial.println("or type custom text (matched against known prompts)");
  Serial.println("OTA commands: 'ota <size>' to upload, 'manifest <size>', 'push' to broadcast");
}

void loop() {
  ota_push_tick();

  if (!Serial.available()) return;
  String line = Serial.readStringUntil('\n');
  line.trim();
  if (line.length() == 0) return;

  // OTA commands.
  if (line.startsWith("ota ")) {
    uint32_t size = (uint32_t)line.substring(4).toInt();
    if (size > 0) ota_push_upload(size);
    else Serial.println("usage: ota <size_bytes>");
    return;
  }
  if (line.startsWith("manifest ")) {
    uint32_t size = (uint32_t)line.substring(9).toInt();
    if (size > 0) ota_push_upload_manifest(size);
    else Serial.println("usage: manifest <size_bytes>");
    return;
  }
  if (line == "push") {
    ota_push_start();
    return;
  }

  // Check for numeric shortcut.
  if (line.length() == 1 && line[0] >= '1' && line[0] <= '0' + N_PROMPTS) {
    int idx = line[0] - '1';
    Serial.printf("sending: \"%s\"\n>>> ", PROMPTS[idx].text);
    send_prompt(PROMPTS[idx].ids, PROMPTS[idx].n);
    return;
  }

  // Try to match against known prompts (case-insensitive prefix).
  line.toLowerCase();
  for (int i = 0; i < N_PROMPTS; i++) {
    if (line.startsWith(PROMPTS[i].text)) {
      Serial.printf("matched: \"%s\"\n>>> ", PROMPTS[i].text);
      send_prompt(PROMPTS[i].ids, PROMPTS[i].n);
      return;
    }
  }

  // No match -- send the default prompt.
  Serial.printf("no tokenizer on-device; sending default (\"Once upon a time\")\n>>> ");
  send_prompt(IDS_ONCE, 4);
}
