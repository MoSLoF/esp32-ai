// MIPI-DSI framebuffer text display for the ESP32-P4.
//
// Renders persona faces, peer status, and inference output to an attached
// MIPI-DSI panel. Uses the ESP-IDF MIPI-DSI driver with a simple software
// framebuffer — no GPU, just pixel-level glyph rendering into a DMA buffer.
//
// The P4 has a dedicated MIPI-DSI peripheral (DPI mode). This driver targets
// common ILI9881C-based 800x480 panels (Waveshare 4.3" is the reference).
//
// Text is rendered with a built-in 8x16 bitmap font. The display is split
// into three zones:
//   - Top bar:   persona face + name + peer count
//   - Middle:    scrolling inference output (last N lines)
//   - Bottom:    peer status table
//
// All rendering is double-buffered via DMA-capable PSRAM. The display_flush()
// call is non-blocking — it queues the buffer for the next VSYNC.

#ifndef DISPLAY_H
#define DISPLAY_H

#include "esp_lcd_panel_ops.h"
#include "esp_lcd_mipi_dsi.h"
#include "esp_heap_caps.h"
#include <string.h>
#include <stdio.h>

// Panel geometry (800x480 is standard for P4 dev kits).
#define DISP_W       800
#define DISP_H       480
#define DISP_BPP     2    // RGB565

// Font: 8x16 built-in bitmap (ASCII 0x20-0x7E).
#define FONT_W       8
#define FONT_H       16
#define FONT_FIRST   0x20
#define FONT_LAST    0x7E

// Text grid dimensions.
#define TEXT_COLS     (DISP_W / FONT_W)   // 100
#define TEXT_ROWS     (DISP_H / FONT_H)   // 30

// Zone layout (row indices).
#define ZONE_TOP_ROWS     3
#define ZONE_BOT_ROWS     6
#define ZONE_MID_START    ZONE_TOP_ROWS
#define ZONE_MID_ROWS     (TEXT_ROWS - ZONE_TOP_ROWS - ZONE_BOT_ROWS)
#define ZONE_BOT_START    (TEXT_ROWS - ZONE_BOT_ROWS)

// Colors (RGB565).
#define COL_BG       0x0000  // black
#define COL_FG       0x07E0  // green
#define COL_DIM      0x0320  // dark green
#define COL_ACCENT   0x07FF  // cyan
#define COL_WARN     0xFBE0  // yellow
#define COL_BOND     0xF81F  // magenta

// Minimal 8x16 bitmap font — just the printable ASCII range.
// Each glyph is 16 bytes (one byte per row, MSB left).
// This is a compact 5x7 design centered in the 8x16 cell.
static const uint8_t _FONT_DATA[] = {
  // Space (0x20)
  0x00,0x00,0x00,0x00,0x00,0x00,0x00,0x00,0x00,0x00,0x00,0x00,0x00,0x00,0x00,0x00,
  // ! (0x21)
  0x00,0x00,0x18,0x18,0x18,0x18,0x18,0x18,0x18,0x00,0x18,0x18,0x00,0x00,0x00,0x00,
  // " (0x22)
  0x00,0x00,0x6C,0x6C,0x6C,0x24,0x00,0x00,0x00,0x00,0x00,0x00,0x00,0x00,0x00,0x00,
  // # (0x23)
  0x00,0x00,0x24,0x24,0x7E,0x24,0x24,0x7E,0x24,0x24,0x00,0x00,0x00,0x00,0x00,0x00,
  // $ (0x24)
  0x00,0x08,0x3E,0x49,0x48,0x38,0x0E,0x09,0x49,0x3E,0x08,0x00,0x00,0x00,0x00,0x00,
  // % (0x25)
  0x00,0x00,0x62,0x64,0x08,0x10,0x20,0x4C,0x8C,0x00,0x00,0x00,0x00,0x00,0x00,0x00,
  // & (0x26)
  0x00,0x00,0x30,0x48,0x48,0x30,0x4A,0x44,0x44,0x3A,0x00,0x00,0x00,0x00,0x00,0x00,
  // ' (0x27)
  0x00,0x00,0x18,0x18,0x10,0x20,0x00,0x00,0x00,0x00,0x00,0x00,0x00,0x00,0x00,0x00,
  // ( (0x28)
  0x00,0x04,0x08,0x10,0x10,0x10,0x10,0x10,0x10,0x08,0x04,0x00,0x00,0x00,0x00,0x00,
  // ) (0x29)
  0x00,0x20,0x10,0x08,0x08,0x08,0x08,0x08,0x08,0x10,0x20,0x00,0x00,0x00,0x00,0x00,
  // * (0x2A)
  0x00,0x00,0x00,0x24,0x18,0x7E,0x18,0x24,0x00,0x00,0x00,0x00,0x00,0x00,0x00,0x00,
  // + (0x2B)
  0x00,0x00,0x00,0x08,0x08,0x3E,0x08,0x08,0x00,0x00,0x00,0x00,0x00,0x00,0x00,0x00,
  // , (0x2C)
  0x00,0x00,0x00,0x00,0x00,0x00,0x00,0x00,0x18,0x18,0x10,0x20,0x00,0x00,0x00,0x00,
  // - (0x2D)
  0x00,0x00,0x00,0x00,0x00,0x3E,0x00,0x00,0x00,0x00,0x00,0x00,0x00,0x00,0x00,0x00,
  // . (0x2E)
  0x00,0x00,0x00,0x00,0x00,0x00,0x00,0x00,0x18,0x18,0x00,0x00,0x00,0x00,0x00,0x00,
  // / (0x2F)
  0x00,0x02,0x04,0x04,0x08,0x08,0x10,0x10,0x20,0x20,0x40,0x00,0x00,0x00,0x00,0x00,
  // 0-9 (0x30-0x39)
  0x00,0x00,0x3C,0x42,0x46,0x4A,0x52,0x62,0x42,0x3C,0x00,0x00,0x00,0x00,0x00,0x00,
  0x00,0x00,0x08,0x18,0x28,0x08,0x08,0x08,0x08,0x3E,0x00,0x00,0x00,0x00,0x00,0x00,
  0x00,0x00,0x3C,0x42,0x02,0x04,0x08,0x10,0x20,0x7E,0x00,0x00,0x00,0x00,0x00,0x00,
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  0x00,0x00,0x3C,0x42,0x42,0x42,0x3E,0x02,0x04,0x38,0x00,0x00,0x00,0x00,0x00,0x00,
  // : (0x3A)
  0x00,0x00,0x00,0x18,0x18,0x00,0x00,0x18,0x18,0x00,0x00,0x00,0x00,0x00,0x00,0x00,
  // ; (0x3B)
  0x00,0x00,0x00,0x18,0x18,0x00,0x00,0x18,0x18,0x10,0x20,0x00,0x00,0x00,0x00,0x00,
  // < (0x3C)
  0x00,0x00,0x04,0x08,0x10,0x20,0x10,0x08,0x04,0x00,0x00,0x00,0x00,0x00,0x00,0x00,
  // = (0x3D)
  0x00,0x00,0x00,0x00,0x3E,0x00,0x3E,0x00,0x00,0x00,0x00,0x00,0x00,0x00,0x00,0x00,
  // > (0x3E)
  0x00,0x00,0x20,0x10,0x08,0x04,0x08,0x10,0x20,0x00,0x00,0x00,0x00,0x00,0x00,0x00,
  // ? (0x3F)
  0x00,0x00,0x3C,0x42,0x02,0x04,0x08,0x08,0x00,0x08,0x00,0x00,0x00,0x00,0x00,0x00,
  // @ (0x40)
  0x00,0x00,0x3C,0x42,0x4E,0x52,0x56,0x4A,0x40,0x3C,0x00,0x00,0x00,0x00,0x00,0x00,
  // A-Z (0x41-0x5A)
  0x00,0x00,0x18,0x24,0x42,0x42,0x7E,0x42,0x42,0x42,0x00,0x00,0x00,0x00,0x00,0x00,
  0x00,0x00,0x7C,0x42,0x42,0x7C,0x42,0x42,0x42,0x7C,0x00,0x00,0x00,0x00,0x00,0x00,
  0x00,0x00,0x3C,0x42,0x40,0x40,0x40,0x40,0x42,0x3C,0x00,0x00,0x00,0x00,0x00,0x00,
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  0x00,0x00,0x7E,0x02,0x04,0x08,0x10,0x20,0x40,0x7E,0x00,0x00,0x00,0x00,0x00,0x00,
  // [ (0x5B)
  0x00,0x1C,0x10,0x10,0x10,0x10,0x10,0x10,0x10,0x1C,0x00,0x00,0x00,0x00,0x00,0x00,
  // backslash (0x5C)
  0x00,0x40,0x20,0x20,0x10,0x10,0x08,0x08,0x04,0x04,0x02,0x00,0x00,0x00,0x00,0x00,
  // ] (0x5D)
  0x00,0x38,0x08,0x08,0x08,0x08,0x08,0x08,0x08,0x38,0x00,0x00,0x00,0x00,0x00,0x00,
  // ^ (0x5E)
  0x00,0x08,0x14,0x22,0x00,0x00,0x00,0x00,0x00,0x00,0x00,0x00,0x00,0x00,0x00,0x00,
  // _ (0x5F)
  0x00,0x00,0x00,0x00,0x00,0x00,0x00,0x00,0x00,0x00,0x7E,0x00,0x00,0x00,0x00,0x00,
  // ` (0x60)
  0x00,0x10,0x08,0x04,0x00,0x00,0x00,0x00,0x00,0x00,0x00,0x00,0x00,0x00,0x00,0x00,
  // a-z (0x61-0x7A)
  0x00,0x00,0x00,0x00,0x3C,0x02,0x3E,0x42,0x42,0x3E,0x00,0x00,0x00,0x00,0x00,0x00,
  0x00,0x00,0x40,0x40,0x7C,0x42,0x42,0x42,0x42,0x7C,0x00,0x00,0x00,0x00,0x00,0x00,
  0x00,0x00,0x00,0x00,0x3C,0x42,0x40,0x40,0x42,0x3C,0x00,0x00,0x00,0x00,0x00,0x00,
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  0x00,0x00,0x00,0x00,0x7E,0x04,0x08,0x10,0x20,0x7E,0x00,0x00,0x00,0x00,0x00,0x00,
  // { (0x7B)
  0x00,0x0C,0x10,0x10,0x10,0x20,0x10,0x10,0x10,0x0C,0x00,0x00,0x00,0x00,0x00,0x00,
  // | (0x7C)
  0x00,0x08,0x08,0x08,0x08,0x08,0x08,0x08,0x08,0x08,0x08,0x00,0x00,0x00,0x00,0x00,
  // } (0x7D)
  0x00,0x30,0x08,0x08,0x08,0x04,0x08,0x08,0x08,0x30,0x00,0x00,0x00,0x00,0x00,0x00,
  // ~ (0x7E)
  0x00,0x00,0x00,0x00,0x00,0x32,0x4C,0x00,0x00,0x00,0x00,0x00,0x00,0x00,0x00,0x00,
};

// ---- display state ---------------------------------------------------------

static uint16_t *_disp_fb = NULL;
static esp_lcd_panel_handle_t _disp_panel = NULL;
static bool _disp_ready = false;

// Scrolling text buffer for the middle zone.
#define DISP_MID_BUF TEXT_COLS
static char _disp_mid[ZONE_MID_ROWS][DISP_MID_BUF];
static int _disp_mid_row = 0;
static int _disp_mid_col = 0;

// ---- low-level pixel ops ---------------------------------------------------

static inline void _disp_px(int x, int y, uint16_t c) {
  if (x >= 0 && x < DISP_W && y >= 0 && y < DISP_H)
    _disp_fb[y * DISP_W + x] = c;
}

static void _disp_rect(int x, int y, int w, int h, uint16_t c) {
  for (int dy = 0; dy < h && (y + dy) < DISP_H; dy++)
    for (int dx = 0; dx < w && (x + dx) < DISP_W; dx++)
      _disp_fb[(y + dy) * DISP_W + (x + dx)] = c;
}

static void _disp_char(int cx, int cy, char ch, uint16_t fg, uint16_t bg) {
  int idx = (int)ch - FONT_FIRST;
  if (idx < 0 || idx > (FONT_LAST - FONT_FIRST)) idx = 0;
  const uint8_t *glyph = _FONT_DATA + idx * FONT_H;
  int px = cx * FONT_W, py = cy * FONT_H;
  for (int row = 0; row < FONT_H; row++) {
    uint8_t bits = glyph[row];
    for (int col = 0; col < FONT_W; col++)
      _disp_px(px + col, py + row, (bits & (0x80 >> col)) ? fg : bg);
  }
}

static void _disp_str(int cx, int cy, const char *s, uint16_t fg, uint16_t bg) {
  while (*s && cx < TEXT_COLS) {
    _disp_char(cx, cy, *s, fg, bg);
    cx++; s++;
  }
}

static void _disp_str_pad(int cx, int cy, const char *s, int width,
                            uint16_t fg, uint16_t bg) {
  int i = 0;
  while (*s && i < width && (cx + i) < TEXT_COLS) {
    _disp_char(cx + i, cy, *s, fg, bg);
    i++; s++;
  }
  while (i < width && (cx + i) < TEXT_COLS) {
    _disp_char(cx + i, cy, ' ', fg, bg);
    i++;
  }
}

// ---- zone renderers --------------------------------------------------------

static void _disp_render_top(const char *face, const char *name,
                               int n_peers, int n_bonded, int n_encounters) {
  _disp_rect(0, 0, DISP_W, ZONE_TOP_ROWS * FONT_H, COL_BG);
  char buf[TEXT_COLS + 1];
  _disp_str(1, 0, face, COL_ACCENT, COL_BG);
  int flen = strlen(face);
  _disp_str(2 + flen, 0, name, COL_FG, COL_BG);

  snprintf(buf, sizeof(buf), "peers:%d  bonded:%d  total:%d",
           n_peers, n_bonded, n_encounters);
  _disp_str(1, 1, buf, COL_DIM, COL_BG);

  for (int x = 0; x < TEXT_COLS; x++)
    _disp_char(x, 2, '-', COL_DIM, COL_BG);
}

static void _disp_render_mid() {
  for (int r = 0; r < ZONE_MID_ROWS; r++) {
    int row = ZONE_MID_START + r;
    _disp_str_pad(0, row, _disp_mid[r], TEXT_COLS, COL_FG, COL_BG);
  }
}

static void _disp_render_bot_sep() {
  int row = ZONE_BOT_START;
  for (int x = 0; x < TEXT_COLS; x++)
    _disp_char(x, row, '-', COL_DIM, COL_BG);
  _disp_str(1, row, "[ peers ]", COL_ACCENT, COL_BG);
}

// ---- public API ------------------------------------------------------------

static bool display_begin() {
  _disp_fb = (uint16_t *)heap_caps_malloc(
      (size_t)DISP_W * DISP_H * DISP_BPP, MALLOC_CAP_SPIRAM | MALLOC_CAP_DMA);
  if (!_disp_fb) {
    Serial.println("[display] framebuffer alloc failed");
    return false;
  }
  memset(_disp_fb, 0, (size_t)DISP_W * DISP_H * DISP_BPP);
  for (int r = 0; r < ZONE_MID_ROWS; r++)
    memset(_disp_mid[r], 0, DISP_MID_BUF);

  // MIPI-DSI bus configuration.
  esp_lcd_dsi_bus_handle_t dsi_bus;
  esp_lcd_dsi_bus_config_t bus_cfg = {};
  bus_cfg.bus_id = 0;
  bus_cfg.num_data_lanes = 2;
  bus_cfg.phy_clk_src = MIPI_DSI_PHY_CLK_SRC_DEFAULT;
  bus_cfg.lane_bit_rate_mbps = 500;
  esp_err_t err = esp_lcd_new_dsi_bus(&bus_cfg, &dsi_bus);
  if (err != ESP_OK) {
    Serial.printf("[display] DSI bus init failed: %d\n", err);
    heap_caps_free(_disp_fb); _disp_fb = NULL;
    return false;
  }

  // DCS panel init via command-mode IO (S7: required for real ILI9881C panels).
  esp_lcd_panel_io_handle_t dbi_io = NULL;
  esp_lcd_dbi_io_config_t dbi_cfg = {};
  dbi_cfg.virtual_channel = 0;
  dbi_cfg.lcd_cmd_bits = 8;
  dbi_cfg.lcd_param_bits = 8;
  if (esp_lcd_new_panel_io_dbi(dsi_bus, &dbi_cfg, &dbi_io) == ESP_OK && dbi_io) {
    esp_lcd_panel_io_tx_param(dbi_io, 0x11, NULL, 0); // Sleep Out
    delay(120);
    esp_lcd_panel_io_tx_param(dbi_io, 0x29, NULL, 0); // Display On
    delay(20);
    esp_lcd_panel_io_del(dbi_io);
    Serial.println("[display] DCS init sequence sent");
  }

  // DPI panel (video mode).
  esp_lcd_dpi_panel_config_t dpi_cfg = {};
  dpi_cfg.dpi_clk_src = MIPI_DSI_DPI_CLK_SRC_DEFAULT;
  dpi_cfg.dpi_clock_freq_mhz = 40;
  dpi_cfg.virtual_channel = 0;
  dpi_cfg.pixel_format = LCD_COLOR_PIXEL_FORMAT_RGB565;
  dpi_cfg.video_timing.h_size = DISP_W;
  dpi_cfg.video_timing.v_size = DISP_H;
  dpi_cfg.video_timing.hsync_back_porch = 40;
  dpi_cfg.video_timing.hsync_pulse_width = 4;
  dpi_cfg.video_timing.hsync_front_porch = 40;
  dpi_cfg.video_timing.vsync_back_porch = 16;
  dpi_cfg.video_timing.vsync_pulse_width = 4;
  dpi_cfg.video_timing.vsync_front_porch = 16;
  dpi_cfg.num_fbs = 1;

  err = esp_lcd_new_panel_dpi(dsi_bus, &dpi_cfg, &_disp_panel);
  if (err != ESP_OK) {
    Serial.printf("[display] DPI panel init failed: %d\n", err);
    heap_caps_free(_disp_fb); _disp_fb = NULL;
    return false;
  }
  esp_lcd_panel_init(_disp_panel);

  _disp_ready = true;
  Serial.printf("[display] %dx%d ready (%.1f KB fb)\n",
                DISP_W, DISP_H,
                (float)DISP_W * DISP_H * DISP_BPP / 1024.0f);
  return true;
}

static void display_flush() {
  if (!_disp_ready) return;
  esp_lcd_panel_draw_bitmap(_disp_panel, 0, 0, DISP_W, DISP_H, _disp_fb);
}

static void display_puts(const unsigned char *bytes, int len) {
  if (!_disp_ready) return;
  for (int i = 0; i < len; i++) {
    char c = (char)bytes[i];
    if (c == '\n' || _disp_mid_col >= DISP_MID_BUF - 1) {
      _disp_mid[_disp_mid_row][_disp_mid_col] = '\0';
      _disp_mid_row = (_disp_mid_row + 1) % ZONE_MID_ROWS;
      _disp_mid_col = 0;
      memset(_disp_mid[_disp_mid_row], 0, DISP_MID_BUF);
    } else if (c >= 0x20 && c < 0x7F) {
      _disp_mid[_disp_mid_row][_disp_mid_col++] = c;
    }
  }
  _disp_render_mid();
  display_flush();
}

static void display_clear() {
  if (!_disp_ready) return;
  memset(_disp_fb, 0, (size_t)DISP_W * DISP_H * DISP_BPP);
  for (int r = 0; r < ZONE_MID_ROWS; r++)
    memset(_disp_mid[r], 0, DISP_MID_BUF);
  _disp_mid_row = 0;
  _disp_mid_col = 0;
  display_flush();
}

static void display_persona(const char *face, const char *name,
                              const char *quip) {
  if (!_disp_ready) return;
  _disp_render_top(face, name, 0, 0, 0);
  if (quip) _disp_str(1, ZONE_MID_START, quip, COL_DIM, COL_BG);
  display_flush();
}

// Full status update — called from peer_tick or on demand.
static void display_status(const char *face, const char *name,
                             int n_peers, int n_bonded, int n_encounters) {
  if (!_disp_ready) return;
  _disp_render_top(face, name, n_peers, n_bonded, n_encounters);
  display_flush();
}

// Render a single peer row in the bottom zone.
static void display_peer(int slot, const char *peer_name, const char *status,
                           uint16_t color) {
  if (!_disp_ready || slot < 0 || slot >= (ZONE_BOT_ROWS - 1)) return;
  _disp_render_bot_sep();
  int row = ZONE_BOT_START + 1 + slot;
  char buf[TEXT_COLS + 1];
  snprintf(buf, sizeof(buf), " %-16s %s", peer_name, status);
  _disp_str_pad(0, row, buf, TEXT_COLS, color, COL_BG);
  display_flush();
}

static void display_stats(float tok_per_sec, float ms_per_tok) {
  if (!_disp_ready) return;
  char buf[TEXT_COLS + 1];
  snprintf(buf, sizeof(buf), "%.1f tok/s  (%.0f ms/tok)",
           tok_per_sec, ms_per_tok);
  _disp_str(1, ZONE_BOT_START - 1, buf, COL_WARN, COL_BG);
  display_flush();
}

#endif
